## configs/allwinner_suniv_8m_defconfig
```kconfig
BR2_arm=y
BR2_ARM_INSTRUCTIONS_THUMB=y
BR2_SVN="svn"
BR2_CCACHE=y
BR2_SHARED_STATIC_LIBS=y
BR2_GLOBAL_PATCH_DIR="$(BR2_EXTERNAL_SUNIVBOARD_PATH)/patches"
BR2_TOOLCHAIN_BUILDROOT_WCHAR=y
# BR2_UCLIBC_INSTALL_UTILS is not set
BR2_PACKAGE_HOST_LINUX_HEADERS_CUSTOM_5_5=y
BR2_TOOLCHAIN_BUILDROOT_CXX=y
BR2_TARGET_GENERIC_HOSTNAME="sunivboard"
BR2_TARGET_GENERIC_ISSUE="Linux for Human Being!"
BR2_TARGET_GENERIC_GETTY_PORT="/dev/ttyS0"
BR2_TARGET_GENERIC_GETTY_BAUDRATE_115200=y
# BR2_TARGET_GENERIC_REMOUNT_ROOTFS_RW is not set
BR2_ROOTFS_OVERLAY="$(BR2_EXTERNAL_SUNIVBOARD_PATH)/board/sunivboard_v1/rootfs_overlay"
BR2_ROOTFS_POST_BUILD_SCRIPT="$(BR2_EXTERNAL_SUNIVBOARD_PATH)/board/sunivboard_v1/script/post-build.sh"
BR2_ROOTFS_POST_IMAGE_SCRIPT="support/scripts/genimage.sh"
BR2_ROOTFS_POST_SCRIPT_ARGS="-c $(BR2_EXTERNAL_SUNIVBOARD_PATH)/board/sunivboard_v1/script/genimage.cfg"

BR2_LINUX_KERNEL=y
BR2_LINUX_KERNEL_CUSTOM_VERSION=y
BR2_LINUX_KERNEL_CUSTOM_VERSION_VALUE="5.5"
BR2_LINUX_KERNEL_PATCH="$(BR2_EXTERNAL_SUNIVBOARD_PATH)/board/sunivboard_v1/patch/linux"
BR2_LINUX_KERNEL_USE_CUSTOM_CONFIG=y
BR2_LINUX_KERNEL_CUSTOM_CONFIG_FILE="$(BR2_EXTERNAL_SUNIVBOARD_PATH)/board/sunivboard_v1/config/linux_defconfig"
BR2_LINUX_KERNEL_DTS_SUPPORT=y
BR2_LINUX_KERNEL_CUSTOM_DTS_PATH="$(BR2_EXTERNAL_SUNIVBOARD_PATH)/board/sunivboard_v1/dts/linux/sunivboard.dts"
BR2_PACKAGE_DHRYSTONE=y
BR2_PACKAGE_STRESS=y
BR2_PACKAGE_MTD=y
# BR2_PACKAGE_MTD_FLASHCP is not set
# BR2_PACKAGE_MTD_FLASH_ERASE is not set
# BR2_PACKAGE_MTD_FLASH_LOCK is not set
# BR2_PACKAGE_MTD_FLASH_UNLOCK is not set
# BR2_PACKAGE_MTD_MTD_DEBUG is not set
# BR2_PACKAGE_MTD_NANDDUMP is not set
# BR2_PACKAGE_MTD_NANDTEST is not set
# BR2_PACKAGE_MTD_NANDWRITE is not set

# BR2_PACKAGE_MICROPYTHON=y
# BR2_PACKAGE_MICROPYTHON_LIB=y

BR2_PACKAGE_LIBTIRPC=y
# BR2_PACKAGE_IFUPDOWN_SCRIPTS is not set
BR2_TARGET_ROOTFS_SQUASHFS=y
BR2_TARGET_ROOTFS_SQUASHFS4_XZ=y
#BR2_TARGET_ROOTFS_TAR is not set

BR2_TARGET_ROOTFS_JFFS2=y
BR2_TARGET_ROOTFS_JFFS2_CUSTOM=y
BR2_TARGET_ROOTFS_JFFS2_CUSTOM_EBSIZE=0x10000
BR2_TARGET_ROOTFS_JFFS2_PAD=y

BR2_TARGET_UBOOT=y
BR2_TARGET_UBOOT_BUILD_SYSTEM_KCONFIG=y
BR2_TARGET_UBOOT_CUSTOM_VERSION=y
BR2_TARGET_UBOOT_CUSTOM_VERSION_VALUE="2020.07"
BR2_TARGET_UBOOT_PATCH="$(BR2_EXTERNAL_SUNIVBOARD_PATH)/board/sunivboard_v1/patch/uboot"
BR2_TARGET_UBOOT_USE_CUSTOM_CONFIG=y
BR2_TARGET_UBOOT_CUSTOM_CONFIG_FILE="$(BR2_EXTERNAL_SUNIVBOARD_PATH)/board/sunivboard_v1/config/uboot_defconfig"
BR2_TARGET_UBOOT_CONFIG_FRAGMENT_FILES="$(BR2_EXTERNAL_SUNIVBOARD_PATH)/board/sunivboard_v1/config/uboot-fragment.config"

BR2_TARGET_UBOOT_NEEDS_DTC=y
BR2_TARGET_UBOOT_NEEDS_PYLIBFDT=y
# BR2_TARGET_UBOOT_FORMAT_BIN is not set
BR2_TARGET_UBOOT_FORMAT_CUSTOM=y
BR2_TARGET_UBOOT_FORMAT_CUSTOM_NAME="u-boot-sunxi-with-spl.bin"
BR2_TARGET_UBOOT_CUSTOM_DTS_PATH="$(BR2_EXTERNAL_SUNIVBOARD_PATH)/board/sunivboard_v1/dts/uboot/suniv-f1c100s-uboot.dtsi $(BR2_EXTERNAL_SUNIVBOARD_PATH)/board/sunivboard_v1/dts/uboot/sunivboard.dts"
BR2_PACKAGE_HOST_MKPASSWD=y
BR2_PACKAGE_HOST_MTD=y
BR2_PACKAGE_HOST_SUNXI_TOOLS_F1C100S=y
BR2_PACKAGE_HOST_GENIMAGE=y
```

## configs/allwinner_suniv_defconfig
```kconfig
BR2_arm=y
BR2_ARM_INSTRUCTIONS_THUMB=y
BR2_SVN="svn"
BR2_CCACHE=y
BR2_SHARED_STATIC_LIBS=y
BR2_GLOBAL_PATCH_DIR="$(BR2_EXTERNAL_SUNIVBOARD_PATH)/patches"
BR2_KERNEL_HEADERS_5_1=y
BR2_TOOLCHAIN_BUILDROOT_WCHAR=y
# BR2_UCLIBC_INSTALL_UTILS is not set
BR2_GCC_VERSION_8_X=y
BR2_TOOLCHAIN_BUILDROOT_CXX=y
BR2_TARGET_GENERIC_HOSTNAME="sunivboard"
BR2_TARGET_GENERIC_ISSUE="Linux for Human Being!"
BR2_TARGET_GENERIC_GETTY_PORT="/dev/ttyS0"
BR2_TARGET_GENERIC_GETTY_BAUDRATE_115200=y
# BR2_TARGET_GENERIC_REMOUNT_ROOTFS_RW is not set
BR2_ROOTFS_OVERLAY="$(BR2_EXTERNAL_SUNIVBOARD_PATH)/board/sunivboard/rootfs_overlay"
BR2_ROOTFS_POST_BUILD_SCRIPT="$(BR2_EXTERNAL_SUNIVBOARD_PATH)/board/sunivboard/v1/post-build.sh"
BR2_ROOTFS_POST_IMAGE_SCRIPT="support/scripts/genimage.sh"
BR2_ROOTFS_POST_SCRIPT_ARGS="-c $(BR2_EXTERNAL_SUNIVBOARD_PATH)/board/sunivboard/v1/genimage_winbond128.cfg"
BR2_LINUX_KERNEL=y
BR2_LINUX_KERNEL_CUSTOM_GIT=y
BR2_LINUX_KERNEL_CUSTOM_REPO_URL="https://github.com/ty3ry/linux.git"
BR2_LINUX_KERNEL_CUSTOM_REPO_VERSION="e9b75c60f91a359cb0e1b2d0a9ed1c81485215e2"
BR2_LINUX_KERNEL_USE_CUSTOM_CONFIG=y
BR2_LINUX_KERNEL_CUSTOM_CONFIG_FILE="$(BR2_EXTERNAL_SUNIVBOARD_PATH)/board/sunivboard/v1/linux_defconfig"
BR2_LINUX_KERNEL_DTS_SUPPORT=y
BR2_LINUX_KERNEL_CUSTOM_DTS_PATH="$(BR2_EXTERNAL_SUNIVBOARD_PATH)/board/sunivboard/v1/dts/sunivboard.dts"
BR2_PACKAGE_DHRYSTONE=y
BR2_PACKAGE_STRESS=y
BR2_PACKAGE_MTD=y
# BR2_PACKAGE_MTD_FLASHCP is not set
# BR2_PACKAGE_MTD_FLASH_ERASE is not set
# BR2_PACKAGE_MTD_FLASH_LOCK is not set
# BR2_PACKAGE_MTD_FLASH_UNLOCK is not set
# BR2_PACKAGE_MTD_MTD_DEBUG is not set
# BR2_PACKAGE_MTD_NANDDUMP is not set
# BR2_PACKAGE_MTD_NANDTEST is not set
# BR2_PACKAGE_MTD_NANDWRITE is not set

# BR2_PACKAGE_MICROPYTHON=y
# BR2_PACKAGE_MICROPYTHON_LIB=y

# busybox
BR2_PACKAGE_BUSYBOX_CONFIG="package/busybox/busybox.config"

BR2_PACKAGE_LIBTIRPC=y
# BR2_PACKAGE_IFUPDOWN_SCRIPTS is not set
BR2_TARGET_ROOTFS_SQUASHFS=y
BR2_TARGET_ROOTFS_SQUASHFS4_XZ=y
# BR2_TARGET_ROOTFS_TAR is not set
BR2_TARGET_UBOOT=y
BR2_TARGET_UBOOT_BUILD_SYSTEM_KCONFIG=y
BR2_TARGET_UBOOT_CUSTOM_GIT=y
BR2_TARGET_UBOOT_CUSTOM_REPO_URL="https://github.com/ty3ry/u-boot.git"
BR2_TARGET_UBOOT_CUSTOM_REPO_VERSION="3c99166441bf3ea325af2da83cfe65430b49c066"
#"e9a861c19c620224f5c1224cd7033b02adb8fa4d"
BR2_TARGET_UBOOT_USE_CUSTOM_CONFIG=y
BR2_TARGET_UBOOT_CUSTOM_CONFIG_FILE="$(BR2_EXTERNAL_SUNIVBOARD_PATH)/board/sunivboard/v1/uboot_defconfig"
BR2_TARGET_UBOOT_NEEDS_DTC=y
BR2_TARGET_UBOOT_NEEDS_PYLIBFDT=y
# BR2_TARGET_UBOOT_FORMAT_BIN is not set
BR2_TARGET_UBOOT_FORMAT_CUSTOM=y
BR2_TARGET_UBOOT_FORMAT_CUSTOM_NAME="u-boot-sunxi-with-spl.bin"
BR2_TARGET_UBOOT_CUSTOM_DTS_PATH="$(BR2_EXTERNAL_SUNIVBOARD_PATH)/board/sunivboard/v1/uboot-dts/*"
BR2_PACKAGE_HOST_MKPASSWD=y
BR2_PACKAGE_HOST_MTD=y
BR2_PACKAGE_HOST_SUNXI_TOOLS_F1C100S=y
BR2_PACKAGE_HOST_GENIMAGE=y

BR2_PACKAGE_LINUX_FIRMWARE=y
BR2_PACKAGE_LINUX_FIRMWARE_BRCM_BCM43XXX=y

BR2_PACKAGE_IFUPDOWN_SCRIPTS=y
BR2_PACKAGE_IPUTILS=y
BR2_PACKAGE_IW=y
BR2_PACKAGE_MONGREL2_LIBC_SUPPORTS=y
BR2_PACKAGE_WIRELESS_TOOLS=y
BR2_PACKAGE_WIRELESS_TOOLS_LIB=y
BR2_PACKAGE_WPA_SUPPLICANT=y
BR2_PACKAGE_WPA_SUPPLICANT_NL80211=y
BR2_PACKAGE_WPA_SUPPLICANT_CLI=y

BR2_PACKAGE_ALSA_UTILS=y
BR2_PACKAGE_ALSA_UTILS_AMIXER=y
BR2_PACKAGE_ALSA_UTILS_ALSACTL=y
BR2_PACKAGE_ALSA_UTILS_ALSAMIXER=y
BR2_PACKAGE_ALSA_UTILS_APLAY=y
BR2_PACKAGE_ALSA_UTILS_SPEAKER_TEST=y

BR2_PACKAGE_ALSA_LIB=y
BR2_PACKAGE_ALSA_LIB_DEVDIR="/dev/snd"
BR2_PACKAGE_ALSA_LIB_PCM_PLUGINS="all"
BR2_PACKAGE_ALSA_LIB_CTL_PLUGINS="all"
BR2_PACKAGE_ALSA_LIB_ALOAD=y
BR2_PACKAGE_ALSA_LIB_MIXER=y
BR2_PACKAGE_ALSA_LIB_PCM=y
BR2_PACKAGE_ALSA_LIB_RAWMIDI=y
BR2_PACKAGE_ALSA_LIB_HWDEP=y
BR2_PACKAGE_ALSA_LIB_SEQ=y
BR2_PACKAGE_ALSA_LIB_ALISP=y

BR2_ROOTFS_DEVICE_CREATION_DYNAMIC_MDEV=y

BR2_SYSTEM_DHCP="wlan0"
```

## configs/custom_orangepi_zero_defconfig
```kconfig
# Architecture
BR2_arm=y
BR2_cortex_a7=y
BR2_ARM_FPU_VFPV4=y

# System
BR2_TARGET_GENERIC_HOSTNAME="OrangePi_Zero"
BR2_TARGET_GENERIC_ISSUE="Welcome to Buildroot for the Orange Pi Zero"
BR2_GLOBAL_PATCH_DIR="board/orangepi/orangepi-zero/patches"
BR2_ROOTFS_DEVICE_CREATION_DYNAMIC_MDEV=y
BR2_PACKAGE_HOST_LINUX_HEADERS_CUSTOM_5_15=y
BR2_SYSTEM_DHCP="eth0"

BR2_GLOBAL_PATCH_DIR="$(BR2_EXTERNAL_SBCBOARD_PATH)/patches"
BR2_ROOTFS_OVERLAY="$(BR2_EXTERNAL_SBCBOARD_PATH)/board/custom_orangepi_zero/rootfs_overlay"
# Kernel
BR2_LINUX_KERNEL=y
BR2_LINUX_KERNEL_CUSTOM_VERSION=y
BR2_LINUX_KERNEL_CUSTOM_VERSION_VALUE="5.15.16"
BR2_LINUX_KERNEL_PATCH="$(BR2_EXTERNAL_SBCBOARD_PATH)/board/custom_orangepi_zero/patch/linux"
#BR2_LINUX_KERNEL_DEFCONFIG="sunxi"
BR2_LINUX_KERNEL_USE_CUSTOM_CONFIG=y
BR2_LINUX_KERNEL_CUSTOM_CONFIG_FILE="$(BR2_EXTERNAL_SBCBOARD_PATH)/board/custom_orangepi_zero/config/linux/linux_defconfig"
BR2_LINUX_KERNEL_DTS_SUPPORT=y
BR2_LINUX_KERNEL_CUSTOM_DTS_PATH="$(BR2_EXTERNAL_SBCBOARD_PATH)/board/custom_orangepi_zero/dts/linux/sun8i-h2-plus-orangepi-zero.dts"
BR2_LINUX_KERNEL_INTREE_DTS_NAME="sun8i-h2-plus-orangepi-zero"
BR2_LINUX_KERNEL_CONFIG_FRAGMENT_FILES="board/orangepi/orangepi-zero/linux-extras.fragment"
BR2_LINUX_KERNEL_NEEDS_HOST_OPENSSL=y
BR2_LINUX_KERNEL_INSTALL_TARGET=y

# Filesystem
BR2_TARGET_ROOTFS_EXT2=y
BR2_TARGET_ROOTFS_EXT2_4=y
# BR2_TARGET_ROOTFS_TAR is not set

# Bootloader
BR2_TARGET_UBOOT=y
BR2_TARGET_UBOOT_BUILD_SYSTEM_KCONFIG=y
BR2_TARGET_UBOOT_CUSTOM_VERSION=y
BR2_TARGET_UBOOT_CUSTOM_VERSION_VALUE="2022.01"
BR2_TARGET_UBOOT_BOARD_DEFCONFIG="orangepi_zero"
BR2_TARGET_UBOOT_NEEDS_DTC=y
BR2_TARGET_UBOOT_NEEDS_PYTHON3=y
BR2_TARGET_UBOOT_NEEDS_PYLIBFDT=y
BR2_TARGET_UBOOT_SPL=y
BR2_TARGET_UBOOT_SPL_NAME="u-boot-sunxi-with-spl.bin"
BR2_TARGET_UBOOT_USE_CUSTOM_CONFIG=y
BR2_TARGET_UBOOT_CUSTOM_CONFIG_FILE="$(BR2_EXTERNAL_SBCBOARD_PATH)/board/custom_orangepi_zero/config/uboot/uboot_defconfig"

# Required tools to create the SD image
BR2_PACKAGE_HOST_GENIMAGE=y

# Image
BR2_ROOTFS_POST_BUILD_SCRIPT="board/orangepi/common/post-build.sh"
BR2_ROOTFS_POST_IMAGE_SCRIPT="support/scripts/genimage.sh"
BR2_ROOTFS_POST_SCRIPT_ARGS="-c $(BINARIES_DIR)/genimage.cfg"

# Wireless driver and firmware
BR2_PACKAGE_XR819_XRADIO=y
BR2_PACKAGE_ARMBIAN_FIRMWARE=y
BR2_PACKAGE_ARMBIAN_FIRMWARE_XR819=y

# Wireless support
BR2_PACKAGE_IW=y
BR2_PACKAGE_WIRELESS_TOOLS=y
BR2_PACKAGE_WIRELESS_TOOLS_LIB=y
BR2_PACKAGE_WPA_SUPPLICANT=y
BR2_PACKAGE_WPA_SUPPLICANT_NL80211=y
BR2_PACKAGE_WPA_SUPPLICANT_CLI=y

# Spi flash support
BR2_PACKAGE_MTD=y

BR2_PACKAGE_ALSA_UTILS=y
BR2_PACKAGE_ALSA_UTILS_AMIXER=y
BR2_PACKAGE_ALSA_UTILS_ALSACTL=y
BR2_PACKAGE_ALSA_UTILS_ALSAMIXER=y
BR2_PACKAGE_ALSA_UTILS_APLAY=y
BR2_PACKAGE_ALSA_UTILS_SPEAKER_TEST=y

BR2_PACKAGE_ALSA_LIB=y
BR2_PACKAGE_ALSA_LIB_DEVDIR="/dev/snd"
BR2_PACKAGE_ALSA_LIB_PCM_PLUGINS="all"
BR2_PACKAGE_ALSA_LIB_CTL_PLUGINS="all"
BR2_PACKAGE_ALSA_LIB_ALOAD=y
BR2_PACKAGE_ALSA_LIB_MIXER=y
BR2_PACKAGE_ALSA_LIB_PCM=y
BR2_PACKAGE_ALSA_LIB_RAWMIDI=y
BR2_PACKAGE_ALSA_LIB_HWDEP=y
BR2_PACKAGE_ALSA_LIB_SEQ=y
BR2_PACKAGE_ALSA_LIB_ALISP=y

BR2_TOOLCHAIN_BUILDROOT_CXX=y
```

## configs/custom_raspberrypi3_defconfig
```kconfig
BR2_arm=y
BR2_cortex_a53=y
BR2_ARM_FPU_NEON_VFPV4=y

BR2_TOOLCHAIN_BUILDROOT_CXX=y

BR2_SYSTEM_DHCP="eth0"

# Linux headers same as kernel, a 5.10 series
BR2_PACKAGE_HOST_LINUX_HEADERS_CUSTOM_5_10=y

BR2_LINUX_KERNEL=y
BR2_LINUX_KERNEL_CUSTOM_TARBALL=y
BR2_LINUX_KERNEL_CUSTOM_TARBALL_LOCATION="$(call github,raspberrypi,linux,0b54dbda3cca2beb51e236a25738784e90853b64)/linux-0b54dbda3cca2beb51e236a25738784e90853b64.tar.gz"
BR2_LINUX_KERNEL_DEFCONFIG="bcm2709"

# Build the DTB from the kernel sources
BR2_LINUX_KERNEL_DTS_SUPPORT=y
BR2_LINUX_KERNEL_INTREE_DTS_NAME="bcm2710-rpi-3-b bcm2710-rpi-3-b-plus bcm2710-rpi-cm3"

BR2_LINUX_KERNEL_NEEDS_HOST_OPENSSL=y

BR2_PACKAGE_RPI_FIRMWARE=y
BR2_PACKAGE_RPI_FIRMWARE_BOOTCODE_BIN=y
BR2_PACKAGE_RPI_FIRMWARE_VARIANT_PI=y
BR2_PACKAGE_RPI_FIRMWARE_CONFIG_FILE="$(BR2_EXTERNAL_SBCBOARD_PATH)/board/custom_raspberrypi3/config/config_3.txt"

# Required tools to create the SD image
BR2_PACKAGE_HOST_DOSFSTOOLS=y
BR2_PACKAGE_HOST_GENIMAGE=y
BR2_PACKAGE_HOST_MTOOLS=y

BR2_ROOTFS_OVERLAY="$(BR2_EXTERNAL_SBCBOARD_PATH)/board/custom_raspberrypi3/rootfs_overlay"

# wireless tools 
BR2_PACKAGE_BRCMFMAC_SDIO_FIRMWARE_RPI=y
BR2_PACKAGE_BRCMFMAC_SDIO_FIRMWARE_RPI_BT=y
BR2_PACKAGE_BRCMFMAC_SDIO_FIRMWARE_RPI_WIFI=y

BR2_PACKAGE_WPA_SUPPLICANT=y
BR2_PACKAGE_WPA_SUPPLICANT_NL80211=y
BR2_PACKAGE_WPA_SUPPLICANT_CLI=y

BR2_SYSTEM_DHCP="wlan0"

BR2_PACKAGE_OPENSSH=y
BR2_PACKAGE_OPENSSH_CLIENT=y
BR2_PACKAGE_OPENSSH_SERVER=y
BR2_PACKAGE_OPENSSH_KEY_UTILS=y


# sound related tools
BR2_PACKAGE_ALSA_UTILS=y
BR2_PACKAGE_ALSA_UTILS_AMIXER=y
BR2_PACKAGE_ALSA_UTILS_ALSACTL=y
BR2_PACKAGE_ALSA_UTILS_ALSAMIXER=y
BR2_PACKAGE_ALSA_UTILS_APLAY=y
BR2_PACKAGE_ALSA_UTILS_SPEAKER_TEST=y

BR2_PACKAGE_ALSA_LIB=y
BR2_PACKAGE_ALSA_LIB_DEVDIR="/dev/snd"
BR2_PACKAGE_ALSA_LIB_PCM_PLUGINS="all"
BR2_PACKAGE_ALSA_LIB_CTL_PLUGINS="all"
BR2_PACKAGE_ALSA_LIB_ALOAD=y
BR2_PACKAGE_ALSA_LIB_MIXER=y
BR2_PACKAGE_ALSA_LIB_PCM=y
BR2_PACKAGE_ALSA_LIB_RAWMIDI=y
BR2_PACKAGE_ALSA_LIB_HWDEP=y
BR2_PACKAGE_ALSA_LIB_SEQ=y
BR2_PACKAGE_ALSA_LIB_ALISP=y

BR2_ROOTFS_DEVICE_CREATION_DYNAMIC_MDEV=y

# Filesystem / image
BR2_TARGET_ROOTFS_EXT2=y
BR2_TARGET_ROOTFS_EXT2_4=y
BR2_TARGET_ROOTFS_EXT2_SIZE="120M"

# BR2_TARGET_ROOTFS_TAR is not set
BR2_ROOTFS_POST_BUILD_SCRIPT="$(BR2_EXTERNAL_SBCBOARD_PATH)/board/custom_raspberrypi3/script/post-build.sh"
BR2_ROOTFS_POST_IMAGE_SCRIPT="$(BR2_EXTERNAL_SBCBOARD_PATH)/board/custom_raspberrypi3/script/post-image.sh"

# used for cspot
BR2_PACKAGE_OPENSSL=y

BR2_PACKAGE_CSPOT=y
BR2_PACKAGE_CSPOT_ALSA=y
```

## package/alsa_control/Config.in
```kconfig
config BR2_PACKAGE_ALSA_CONTROL
	bool "ALSA Control"
	help
	  user application to control alsa related control
```

## package/alsa_test/Config.in
```kconfig
config BR2_PACKAGE_ALSA_TEST
	bool "ALSA testing"
	help
	  user application to test alsa framework
```

## package/cspot/Config.in
```kconfig
config BR2_PACKAGE_CSPOT
	bool "Cspot"
	depends on BR2_USE_MMU # avahi
	depends on !BR2_STATIC_LIBS # avahi
	depends on BR2_TOOLCHAIN_HAS_THREADS
	depends on BR2_INSTALL_LIBSTDCPP
	select BR2_PACKAGE_AVAHI
	select BR2_PACKAGE_AVAHI_DAEMON
	select BR2_PACKAGE_ALSA_LIB

	help
	  A Spotify Connect player written in CPP targeting
	  
	  https://github.com/feelfreelinux/cspot

if BR2_PACKAGE_CSPOT
	config BR2_PACKAGE_CSPOT_ALSA
	bool "alsa_audio"
	default y
	help
		Set audio output to ALSA
endif

comment "A Spotify Connect player written in CPP targeting, but not limited to embedded devices (ESP32)."
	depends on BR2_USE_MMU
	depends on !BR2_INSTALL_LIBSTDCPP || !BR2_TOOLCHAIN_HAS_THREADS \
		|| BR2_STATIC_LIBS
```

## package/dummy_codec/Config.in
```kconfig
config BR2_PACKAGE_DUMMY_CODEC
	bool "Dummy Codec"
	help
	  Dummmy Codec Kernel Module
```

## package/fb_test/Config.in
```kconfig
config BR2_PACKAGE_FB_TEST
	bool "Framebuffer testing"
	help
	  User application to test display framebuffer
```

## package/hifiberry_dac/Config.in
```kconfig
config BR2_PACKAGE_HIFIBERRY_DAC
	bool "Hifiberry DAC"
	help
	  Hifiberry Codec Kernel Module using TI PCM5102A
```

## package/ir_input/Config.in
```kconfig
config BR2_PACKAGE_IR_INPUT
	bool "Test input from IR receiver"
	help
	  Aplication to read input Subsystem /dev/input/event<x>
```

## package/lvgl_test/Config.in
```kconfig
config BR2_PACKAGE_LVGL_TEST
	bool "LVGL test"

	help
	  packge to use and test lvgl display framework

comment "Buildroot test package for LVGL"
```

## package/oled/Config.in
```kconfig
config BR2_PACKAGE_OLED
	bool "oled display"

	help
	  packge to use and test oled SSD1306

comment "Buildroot test package for oled SSD1306 driver"
```

## package/oled_player/Config.in
```kconfig
config BR2_PACKAGE_OLED_PLAYER
	bool "oled player"

	help
	  packge to use and oled with driver SSD1306 as player display ref: https://github.com/antiprism/mpd_oled.git
```

## package/presenter/Config.in
```kconfig
config BR2_PACKAGE_PRESENTER
	bool "Presenter using IR remote"
	help
	  USB HID implementation used to convert IR receiver event to keyboard HID
```

## package/usb_hid/Config.in
```kconfig
config BR2_PACKAGE_USB_HID
	bool "Testing USB HID"
	help
	  user application to test USB HID
```
